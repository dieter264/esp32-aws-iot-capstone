## sdkconfig.defaults
```kconfig
# Target
CONFIG_IDF_TARGET="esp32s3"
CONFIG_IDF_TARGET_ESP32S3=y

# Flash / partition table
CONFIG_ESPTOOLPY_FLASHSIZE_16MB=y
CONFIG_ESPTOOLPY_FLASHSIZE="16MB"
CONFIG_PARTITION_TABLE_CUSTOM=y
CONFIG_PARTITION_TABLE_CUSTOM_FILENAME="partitions.csv"
CONFIG_PARTITION_TABLE_FILENAME="partitions.csv"
CONFIG_PARTITION_TABLE_OFFSET=0xb000 # (i.e. 44K)

# ESP32-S3 N16R8 PSRAM
CONFIG_SPIRAM=y
CONFIG_SPIRAM_MODE_OCT=y
CONFIG_SPIRAM_TYPE_AUTO=y
CONFIG_SPIRAM_SPEED_80M=y
CONFIG_SPIRAM_BOOT_INIT=y
CONFIG_SPIRAM_MEMTEST=y
CONFIG_SPIRAM_USE_MALLOC=y
CONFIG_SPIRAM_MALLOC_ALWAYSINTERNAL=16384
CONFIG_SPIRAM_MALLOC_RESERVE_INTERNAL=32768

# ESP-IDF logging
CONFIG_LOG_DEFAULT_LEVEL_DEBUG=y
CONFIG_LOG_DEFAULT_LEVEL=4
CONFIG_LOG_MAXIMUM_LEVEL=4

# Application logging
CONFIG_APP_LOG_GLOBAL_LEVEL=4
CONFIG_APP_HTTPS_LOG_LEVEL=-1
CONFIG_APP_BME280_LOG_LEVEL=-1
CONFIG_APP_MC_LOG_LEVEL=-1
CONFIG_APP_SNTP_LOG_LEVEL=-1
CONFIG_APP_SM_LOG_LEVEL=-1
CONFIG_APP_WM_LOG_LEVEL=-1

# SNTP / DHCP-provided NTP servers
CONFIG_LWIP_DHCP_GET_NTP_SRV=y
CONFIG_LWIP_SNTP_MAX_SERVERS=3
```
