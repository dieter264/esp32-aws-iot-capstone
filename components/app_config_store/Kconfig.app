## components/app_config_store/Kconfig.app
```kconfig
menu "Config Store"

    config APP_CS_LOG_LEVEL
        int "Log level override"
        range -1 5
        default -1
        help
            -1=use global, 0=NONE..5=VERBOSE

endmenu
```

## components/app_device_manager/Kconfig.app
```kconfig
menu "Device Manager"

    config APP_DM_LOG_LEVEL
        int "Log level override"
        range -1 5
        default -1
        help
            -1=use global, 0=NONE..5=VERBOSE

    config APP_DM_BME280_ENABLED
        bool "Enable BME280 sensor"
        default n
        help
            Enable a connected BME280 sensor.

    config APP_DM_DS18B20_ENABLED
        bool "Enable DS18B20 sensor"
        default n
        help
            Enable a connected DS18B20 sensor.

    config APP_DM_TL136_ENABLED
        bool "Enable TL136 sensor"
        default n
        help
            Enable a connected TL136 sensor.

endmenu
```

## components/app_https_server/Kconfig.app
```kconfig
menu "HTTPS Server"

    config APP_HTTPS_LOGIN_USER
        string "HTTPS login username"
        default "user"
        help
            SSID of the AP a client can connect to.
            Must be 1..31 chars.

    config APP_HTTPS_LOGIN_PASSWD
        string "HTTPS login password"
        default "password$1"
        help
            Password of the AP a client can connect to.
            Must be 8..63 chars.

    config APP_HTTPS_LOG_LEVEL
        int "Log level override"
        range -1 5
        default -1
        help
            -1=use global, 0=NONE..5=VERBOSE

endmenu
```

## components/app_i2c_bme280/Kconfig
```kconfig
menu "BME280"

    config APP_BME280_LOG_LEVEL
        int "Log level override"
        range -1 5
        default -1
        help
            -1=use global, 0=NONE..5=VERBOSE

endmenu
```

## components/app_i2c_bme280/Kconfig.app
```kconfig
menu "BME280"

    config APP_BME280_PROBE_INTERVAL_MS
        int "Sample probe interval (ms)"
        range 1000 3600000
        default 5000
        help
            Interval in milliseconds between two BME280 samples.
            The minimum value of 1000 ms limits sensor reads and MQTT
            publication frequency.

    config APP_BME280_LOG_LEVEL
        int "Log level override"
        range -1 5
        default -1
        help
            -1=use global, 0=NONE..5=VERBOSE

endmenu
```

## components/app_i2c_bus/Kconfig
```kconfig
menu "I2C Master Bus"

    config APP_I2C_BUS_SCL
        int "SCL GPIO number"
        default 4
        help
            GPIO number for I2C Master clock line.

    config APP_I2C_BUS_SDA
        int "SDA GPIO number"
        default 5
        help
            GPIO number for I2C Master data line.

    config APP_I2C_BUS_SCL_SPEED_HZ
        int "Master frequency"
        default 100000
        help
            Default SCL line frequency.

    config APP_I2C_BUS_XFER_TIMEOUT_MS
        int "Wait timeout ms"
        default 50
        help
            Timeout period for ack response, when reading a device.

    config APP_I2C_BUS_LOG_LEVEL
        int "Log level override"
        range -1 5
        default -1
        help
            -1=use global, 0=NONE..5=VERBOSE

endmenu
```

## components/app_modbus_bus/Kconfig.app
```kconfig
menu "Modbus Bus"

    config APP_MODBUS_UART_PORT
        int "UART port number"
        range 0 2 if SOC_UART_HP_NUM > 2
        range 0 1 if SOC_UART_HP_NUM > 1
        range 0 0
        default 1
        help
            UART controller used for the Modbus RTU bus. Select a controller
            that is not used by the console or another component.

    config APP_MODBUS_UART_TX_GPIO
        int "UART TX GPIO number"
        range 0 SOC_GPIO_OUT_RANGE_MAX
        default 17
        help
            GPIO connected to the RS485 transceiver's data input (DI).
            Select an available output-capable GPIO for the board wiring.

    config APP_MODBUS_UART_RX_GPIO
        int "UART RX GPIO number"
        range 0 SOC_GPIO_IN_RANGE_MAX
        default 18
        help
            GPIO connected to the RS485 transceiver's receiver output (RO).
            Select an available input-capable GPIO for the board wiring.

    choice APP_MODBUS_UART_RS485_TRANSCEIVER_SELECTION
        prompt "RS485 transceiver"
        default APP_MODBUS_UART_RS485_TRANSCEIVER_MAX485
        help
            RS485 transceiver connected to the UART. Select MAX485 for
            external direction control through the UART RTS signal, or
            MAX13487E for automatic direction control.

        config APP_MODBUS_UART_RS485_TRANSCEIVER_MAX485
            bool "MAX485"

        config APP_MODBUS_UART_RS485_TRANSCEIVER_MAX13487E
            bool "MAX13487E"
    endchoice

    config APP_MODBUS_UART_RS485_TRANSCEIVER
        int
        default 1 if APP_MODBUS_UART_RS485_TRANSCEIVER_MAX13487E
        default 0
        help
            RS485 transceiver enum value: 0=MAX485, 1=MAX13487E.

    config APP_MODBUS_UART_RTS_GPIO
        int "RS485 direction GPIO number"
        depends on APP_MODBUS_UART_RS485_TRANSCEIVER_MAX485
        range 0 SOC_GPIO_OUT_RANGE_MAX
        default 16
        help
            GPIO connected to the RS485 transceiver's DE and /RE inputs.
            The UART driver uses RTS to switch between transmitting and
            receiving in half-duplex mode.

    config APP_MODBUS_UART_BAUD_RATE
        int "UART baud rate"
        range 1200 115200
        default 9600
        help
            Serial communication speed in bits per second. All devices on
            the Modbus bus must use the same baud rate.

    config APP_MODBUS_RESPONSE_TOUT_MS
        int "Response timeout (ms)"
        range 0 30000
        default 250
        help
            Maximum time to wait for a device response to a request.
            Zero uses the Modbus stack default FMB_MASTER_TIMEOUT_MS_RESPOND.
            Keep nonzero values below FMB_MASTER_MAX_API_BLOCKING_TIME_MS.
            Longer timeouts also increase the time spent probing absent devices.

    choice APP_MODBUS_UART_PARITY_SELECTION
        prompt "UART parity"
        default APP_MODBUS_UART_PARITY_NONE
        help
            Parity used with eight data bits. Select the setting used by
            the devices connected to the Modbus bus.

        config APP_MODBUS_UART_PARITY_NONE
            bool "None"

        config APP_MODBUS_UART_PARITY_EVEN
            bool "Even"

        config APP_MODBUS_UART_PARITY_ODD
            bool "Odd"
    endchoice

    config APP_MODBUS_UART_PARITY
        int
        default 2 if APP_MODBUS_UART_PARITY_EVEN
        default 3 if APP_MODBUS_UART_PARITY_ODD
        default 0
        help
            UART parity enum value: 0=none, 2=even, 3=odd.

    choice APP_MODBUS_UART_STOP_BITS_SELECTION
        prompt "UART stop bits"
        default APP_MODBUS_UART_STOP_BITS_ONE
        help
            Number of stop bits. Select the setting used by the devices
            connected to the Modbus bus.

        config APP_MODBUS_UART_STOP_BITS_ONE
            bool "One"

        config APP_MODBUS_UART_STOP_BITS_TWO
            bool "Two"
    endchoice

    config APP_MODBUS_UART_STOP_BITS
        int
        default 3 if APP_MODBUS_UART_STOP_BITS_TWO
        default 1
        help
            UART stop-bit enum value: 1=one stop bit, 3=two stop bits.

    config APP_MODBUS_BUS_LOG_LEVEL
        int "Log level override"
        range -1 5
        default -1
        help
            -1=use global, 0=NONE..5=VERBOSE

endmenu
```

## components/app_modbus_tl136/Kconfig.app
```kconfig
menu "TL136 water level sensor"

    comment "TL136: 4-20 mA, 0-2 m water; R4CVA02: 5 V, 0-20 mA"
    comment "UART settings are configured under Modbus Bus"

    config APP_MODBUS_TL136_ADDRESS
        int "Modbus device address"
        range 1 247
        default 1
        help
            Address of the R4CVA02 converter connected to the TL136.
            This selects the device to contact; changing this value
            does not reprogram the converter's address.

    config APP_MODBUS_TL136_INPUT_CHANNEL
        int "Converter input channel"
        range 1 2
        default 1
        help
            R4CVA02 input connected to the TL136:
            1 selects IN1, 2 selects IN2.

    config APP_MODBUS_TL136_CALIBRATION_FACTOR
        int "Converter calibration factor (1000 = unity)"
        range 1 65535
        default 1000
        help
            Calibration factor for the selected converter input.
            A value of 1000 leaves the reading unchanged;
            1010 increases it by 1 percent, and 990 decreases it
            by 1 percent.
            This corrects the converter's current measurement
            before conversion to water level.

    config APP_MODBUS_TL136_PROBE_INTERVAL_MS
        int "Water level probe interval (ms)"
        range 1000 3600000
        default 5000
        help
            Interval between water level measurements.
            The minimum interval follows the application's sensor
            polling policy.

    config APP_MODBUS_TL136_FULL_SCALE_LEVEL_MM
        int "Full-scale water level (mm)"
        range 1 65535
        default 2000
        help
            Water level corresponding to the sensor's 20 mA output.
            The 4 mA output corresponds to zero water level.
            Use 2000 for the installed 0-2 m sensor.
            This value describes the sensor's rating; it does not
            change its physical measuring range.

    config APP_MODBUS_TL136_LOG_LEVEL
        int "Log level override"
        range -1 5
        default -1
        help
            -1=use global, 0=NONE..5=VERBOSE

endmenu
```

## components/app_onewire_bus/Kconfig.app
```kconfig
menu "1-Wire Bus"

    config APP_ONEWIRE_BUS_GPIO
        int "1-Wire GPIO number"
        range 0 SOC_GPIO_OUT_RANGE_MAX
        default 15
        help
            GPIO pin connected to the 1-Wire bus data line. The selected pin
            must support both input and output and must not be reserved by the
            board for flash, PSRAM, or another peripheral.

    config APP_ONEWIRE_BUS_MAX_RX_BYTES
        int "Maximum receive size in bytes"
        range 1 255
        default 10
        help
            Largest number of bytes that can be received in one transaction.
            The RMT backend allocates 32 bytes of internal memory for each byte
            configured here. Ten bytes is sufficient for typical 1-Wire ROM
            and DS18B20 transactions.

    config APP_ONEWIRE_BUS_LOG_LEVEL
        int "Log level override"
        range -1 5
        default -1
        help
            -1=use global, 0=NONE..5=VERBOSE

endmenu
```

## components/app_onewire_ds18b20/Kconfig.app
```kconfig
menu "DS18B20"

    config APP_ONEWIRE_DS18B20_ADDRESS
        hex "1-Wire device address"
        range 0 0xFFFFFFFFFFFFFFFF
        default 0x0
        help
            64-bit ROM address of the DS18B20 sensor for the 1-Wire bus.

    config APP_ONEWIRE_DS18B20_PROBE_INTERVAL_MS
        int "Temperature probe interval (ms)"
        range 1000 3600000
        default 5000
        help
            Interval in milliseconds between two temperature measurements.
            The minimum value is 1000 ms, which allows enough time for a
            DS18B20 temperature conversion at 12-bit resolution.

    config APP_ONEWIRE_DS18B20_LOG_LEVEL
        int "Log level override"
        range -1 5
        default -1
        help
            -1=use global, 0=NONE..5=VERBOSE

endmenu
```

## components/app_ota_manager/Kconfig
```kconfig
menu "OTA Manager"

    config APP_OM_LOG_LEVEL
        int "Log level override"
        range -1 5
        default -1
        help
            -1=use global, 0=NONE..5=VERBOSE

endmenu
```

## components/app_resource_manager/Kconfig.app
```kconfig
menu "Resource Manager"

    config APP_RM_LOG_LEVEL
        int "Log level override"
        range -1 5
        default -1
        help
            -1=use global, 0=NONE..5=VERBOSE

endmenu
```

## components/app_sntp_client/Kconfig.app
```kconfig
menu "SNTP Client"

    config APP_SNTP_LOG_LEVEL
        int "Log level override"
        range -1 5
        default -1
        help
            -1=use global, 0=NONE..5=VERBOSE

    config APP_SNTP_ENABLED
        bool "Enable SNTP time synchronization"
        default n
        help
            Enable wall-clock time synchronization using SNTP/NTP.

    if APP_SNTP_ENABLED

        config APP_SNTP_SERVER_FROM_DHCP
            bool "Use NTP server provided by DHCP"
            default n
            help
                Use NTP/SNTP server addresses provided by the DHCP server.

        config APP_SNTP_STATIC_SERVER_1
            string "NTP server 1"
            default ""
            help
                Static NTP server.
                Optional, if DHCP-provided NTP is enabled. In this case the server is
                just used as fallback server. If DHCP-provided NTP is not enabled, this
                server is used for the NTP service.
                Static servers must be configured as a compact list: server 1 must be
                set before server 2 is used.
                Must be 0..63 chars.

        config APP_SNTP_STATIC_SERVER_2
            string "NTP server 2"
            default ""
            help
                Optional second static NTP server.
                Only used when server 1 is also configured; leave this empty unless
                APP_SNTP_STATIC_SERVER_1 is set.
                Must be 0..63 chars.

    endif

endmenu
```

## components/app_state_machine/Kconfig
```kconfig
menu "State Machine"

    config APP_SM_LOG_LEVEL
        int "Log level override"
        range -1 5
        default -1
        help
            -1=use global, 0=NONE..5=VERBOSE

endmenu
```

## components/app_wifi_manager/Kconfig
```kconfig
menu "Wifi Manager"

    config APP_WM_AP_SSID
        string "WiFi AP ssid"
        default "esp-ssid"
        help
            SSID of the AP a client can connect to.
            Must be 1..32 chars.

    config APP_WM_AP_PASSWD
        string "WiFi AP password"
        default "password$1"
        help
            Password of the AP a client can connect to.
            Must be 8..63 chars.

        config APP_WM_AP_CHANNEL
            int "WiFi AP channel"
            range 1 14
            default 1
            help
                WiFi channel (network channel) of the AP  a client can connect to.

    config APP_WM_LOG_LEVEL
        int "Log level override"
        range -1 5
        default -1
        help
            -1=use global, 0=NONE..5=VERBOSE

endmenu
```

## main/Kconfig.projbuild
```kconfig
menu "Application Configuration"

    config APP_LOG_GLOBAL_LEVEL
        int "Global log level (0=NONE..5=VERBOSE)"
        range 0 5
        default 3

    rsource "../components/app_config_store/Kconfig.app"
    rsource "../components/app_device_manager/Kconfig.app"
    rsource "../components/app_https_server/Kconfig.app"
    rsource "../components/app_i2c_bme280/Kconfig.app"
    rsource "../components/app_i2c_bus/Kconfig.app"
    rsource "../components/app_modbus_bus/Kconfig.app"
    rsource "../components/app_modbus_tl136/Kconfig.app"
    rsource "../components/app_mqtt_client/Kconfig.app"
    rsource "../components/app_onewire_bus/Kconfig.app"
    rsource "../components/app_onewire_ds18b20/Kconfig.app"
    rsource "../components/app_ota_manager/Kconfig.app"
    rsource "../components/app_resource_manager/Kconfig.app"
    rsource "../components/app_sntp_client/Kconfig.app"
    rsource "../components/app_state_machine/Kconfig.app"
    rsource "../components/app_wifi_manager/Kconfig.app"

endmenu
```
